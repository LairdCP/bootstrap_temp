## board/sama5d3xek/sama5d3xeknf_uboot_defconfig
```kconfig
CONFIG_SAMA5D3XEK=y
CONFIG_CPU_CLK_528MHZ=y
CONFIG_NANDFLASH=y
# CONFIG_PMECC_AUTO_DETECT is not set
CONFIG_PMECC_CORRECT_BITS_8=y
# CONFIG_USE_ON_DIE_ECC_SUPPORT is not set
CONFIG_IMG_ADDRESS="0x00020000"
CONFIG_JUMP_ADDR="0x23f00000"
CONFIG_MEMTEST=y
CONFIG_DEBUG=y
CONFIG_SCLK=y
CONFIG_SCLK_BYPASS=y
# CONFIG_LOAD_ONE_WIRE is not set
CONFIG_USER_HW_INIT=y
```
